## boards/arm/tuo_button/Kconfig.board
```kconfig
config BOARD_TUO_BUTTON
	bool "TUO Accessories Button PCB"
	depends on SOC_NRF52840_QIAA
```

## boards/arm/tuo_button/Kconfig.defconfig
```kconfig
if BOARD_TUO_BUTTON

config BOARD
   default "tuo_button"

config BT_CTLR
	default BT

endif # BOARD_TUO_BUTTON
```

## boards/arm/tuo_button/tuo_button_defconfig
```kconfig
CONFIG_SOC_SERIES_NRF52X=y
CONFIG_SOC_NRF52840_QIAA=y
CONFIG_BOARD_TUO_BUTTON=y

# Enable MPU
CONFIG_ARM_MPU=y

# Enable hardware stack protection
CONFIG_HW_STACK_PROTECTION=y

# GPIO options
CONFIG_GPIO=y
CONFIG_GPIO_AS_PINRESET=y
```
